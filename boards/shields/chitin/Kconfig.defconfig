## boards/shields/chitin/Kconfig.defconfig
```kconfig
if SHIELD_CHITIN_LEFT || SHIELD_CHITIN_RIGHT

config ZMK_SPLIT
    default y

endif
```

## boards/shields/chitin/Kconfig.shield
```kconfig
config SHIELD_CHITIN_LEFT
		def_bool $(shields_list_contains,chitin_left)

config SHIELD_CHITIN_RIGHT
		def_bool $(shields_list_contains,chitin_right)
```
