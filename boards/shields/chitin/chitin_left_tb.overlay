#include "chitin.dtsi"

&pro_micro_i2c {
    status = "okay";

    trackball_pim447: trackball@0a {
        compatible = "pimoroni,trackball_pim447";
        reg = <0x0A>;

        sensitivity = <64>;
        move-factor = <2>;
        scroll-factor = <1>;

        /* Optional LED (0-255) */
        // led-red = <255>;
        // led-green = <0>;
        // led-blue = <0>;

        /* Optional axis inversion */
        // invert-x;
        // invert-y;

        status = "okay";
    };
};

#if defined(CONFIG_ZMK_SPLIT_ROLE_CENTRAL)
/* Trackball is local on the central side */
&chitin_tb_listener {
    status = "okay";
    device = <&trackball_pim447>;
};
#else
/* Trackball is on a peripheral: proxy it to central */
&chitin_tb_split {
    device = <&trackball_pim447>;
};
#endif